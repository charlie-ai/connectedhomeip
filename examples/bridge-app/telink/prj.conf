## prj.conf
```kconfig
#
#    Copyright (c) 2023-2024 Project CHIP Authors
#
#    Licensed under the Apache License, Version 2.0 (the "License");
#    you may not use this file except in compliance with the License.
#    You may obtain a copy of the License at
#
#        http://www.apache.org/licenses/LICENSE-2.0
#
#    Unless required by applicable law or agreed to in writing, software
#    distributed under the License is distributed on an "AS IS" BASIS,
#    WITHOUT WARRANTIES OR CONDITIONS OF ANY KIND, either express or implied.
#    See the License for the specific language governing permissions and
#    limitations under the License.
#

# This sample uses Kconfig.defaults to set options common for all
# samples. This file should contain only options specific for this sample
# or overrides of default values.

# Enable CHIP
CONFIG_CHIP=y
CONFIG_STD_CPP17=y

# 32770 == 0x8002 (example bridge-app)
CONFIG_CHIP_DEVICE_PRODUCT_ID=32770

# Bluetooth Low Energy configuration
CONFIG_BT_DEVICE_NAME="TelinkBridge"

# Disable Matter OTA DFU
CONFIG_CHIP_OTA_REQUESTOR=n
CONFIG_CHIP_DEVICE_SOFTWARE_VERSION=1

# Disable CHIP shell support
CONFIG_CHIP_LIB_SHELL=n

# Disable factory data support
CONFIG_CHIP_FACTORY_DATA=n
CONFIG_CHIP_FACTORY_DATA_BUILD=n
CONFIG_CHIP_FACTORY_DATA_MERGE_WITH_FIRMWARE=n
CONFIG_CHIP_CERTIFICATION_DECLARATION_STORAGE=n

# Enable Power Management
CONFIG_PM=n

CONFIG_SERIAL=y
CONFIG_UART_INTERRUPT_DRIVEN=y
```

## boards/tlsr9528a.overlay
```dts
/*
* SPDX-License-Identifier: Apache-2.0
*
* Copyright (c) 2024 Telink Semiconductor (Shanghai) Co., Ltd.
*/

/ {
    chosen {
        zephyr,shell-uart = &uart1;
    };
};

&uart1 {
    status = "okay";
    current-speed = <115200>;
    pinctrl-0 = <&uart1_tx_pc6_default &uart1_rx_pc7_default>;
    pinctrl-names = "default";
};
```

## include/AppConfig.h
```c
/*
 *
 *    Copyright (c) 2023 Project CHIP Authors
 *    All rights reserved.
 *
 *    Licensed under the Apache License, Version 2.0 (the "License");
 *    you may not use this file except in compliance with the License.
 *    You may obtain a copy of the License at
 *
 *        http://www.apache.org/licenses/LICENSE-2.0
 *
 *    Unless required by applicable law or agreed to in writing, software
 *    distributed under the License is distributed on an "AS IS" BASIS,
 *    WITHOUT WARRANTIES OR CONDITIONS OF ANY KIND, either express or implied.
 *    See the License for the specific language governing permissions and
 *    limitations under the License.
 */

#pragma once

// ---- Bridge App Example Config ----

#define APP_SET_DEVICE_INFO_PROVIDER 1
#define APP_SET_NETWORK_COMM_ENDPOINT_SEC 0

#define APP_MODULE_USING_UART1 1
```

## include/AppTask.h
```c
/*
 *
 *    Copyright (c) 2023 Project CHIP Authors
 *    All rights reserved.
 *
 *    Licensed under the Apache License, Version 2.0 (the "License");
 *    you may not use this file except in compliance with the License.
 *    You may obtain a copy of the License at
 *
 *        http://www.apache.org/licenses/LICENSE-2.0
 *
 *    Unless required by applicable law or agreed to in writing, software
 *    distributed under the License is distributed on an "AS IS" BASIS,
 *    WITHOUT WARRANTIES OR CONDITIONS OF ANY KIND, either express or implied.
 *    See the License for the specific language governing permissions and
 *    limitations under the License.
 */

#pragma once

#include "AppTaskCommon.h"
class AppTask : public AppTaskCommon
{
public:
    enum Action_t : uint8_t
    {
        ON_ACTION = 0,
        OFF_ACTION,
        LEVEL_ACTION,
        INVALID_ACTION
    };

    void UpdateClusterState(void);
    static void InitServer(intptr_t context);

private:
    friend AppTask & GetAppTask(void);
    friend class AppTaskCommon;

    CHIP_ERROR Init(void);

#if APP_MODULE_USING_UART1
    static void UartShellRollBackTimerTimeoutCallback(struct k_timer * timer);
    static void serial_cb(const struct device * dev, void * user_data);
    static void print_uart(char * buf);
    static int init_uart_shell(void);
    static void process_uart_shell(void);
#endif

    static void LightingActionEventHandler(AppEvent * aEvent);

    static AppTask sAppTask;
};

inline AppTask & GetAppTask(void)
{
    return AppTask::sAppTask;
}
```

## include/CHIPProjectConfig.h
```c
/*
 *
 *    Copyright (c) 2023 Project CHIP Authors
 *    All rights reserved.
 *
 *    Licensed under the Apache License, Version 2.0 (the "License");
 *    you may not use this file except in compliance with the License.
 *    You may obtain a copy of the License at
 *
 *        http://www.apache.org/licenses/LICENSE-2.0
 *
 *    Unless required by applicable law or agreed to in writing, software
 *    distributed under the License is distributed on an "AS IS" BASIS,
 *    WITHOUT WARRANTIES OR CONDITIONS OF ANY KIND, either express or implied.
 *    See the License for the specific language governing permissions and
 *    limitations under the License.
 */

/**
 *    @file
 *          Example project configuration file for CHIP.
 *
 *          This is a place to put application or project-specific overrides
 *          to the default configuration values for general CHIP features.
 *
 */

#pragma once

// Use a default pairing code if one hasn't been provisioned in flash.
#define CHIP_DEVICE_CONFIG_USE_TEST_SETUP_PIN_CODE 20202021
#define CHIP_DEVICE_CONFIG_USE_TEST_SETUP_DISCRIMINATOR 0xF00

//  Switching from Thread child to router may cause a few second packet stall.
//  Until this is improved in OpenThread we need to increase the retransmission
//  interval to survive the stall.
#define CHIP_CONFIG_MRP_LOCAL_ACTIVE_RETRY_INTERVAL (1000_ms32)

#define CHIP_DEVICE_CONFIG_DYNAMIC_ENDPOINT_COUNT 6
```

## include/Device.h
```c
/*
 *
 *    Copyright (c) 2023 Project CHIP Authors
 *
 *    Licensed under the Apache License, Version 2.0 (the "License");
 *    you may not use this file except in compliance with the License.
 *    You may obtain a copy of the License at
 *
 *        http://www.apache.org/licenses/LICENSE-2.0
 *
 *    Unless required by applicable law or agreed to in writing, software
 *    distributed under the License is distributed on an "AS IS" BASIS,
 *    WITHOUT WARRANTIES OR CONDITIONS OF ANY KIND, either express or implied.
 *    See the License for the specific language governing permissions and
 *    limitations under the License.
 */
#pragma once

#include <app/util/attribute-storage.h>

#include <functional>
#include <stdbool.h>
#include <string>

#include <stdint.h>

class Device
{
public:
    static const int kDeviceNameSize     = 32;
    static const int kDeviceLocationSize = 32;

    enum State_t
    {
        kState_On = 0,
        kState_Off,
    } State;

    enum Changed_t
    {
        kChanged_Reachable         = 0x0001,
        kChanged_State             = 0x0002,
        kChanged_Location          = 0x0004,
        kChanged_Name              = 0x0008,
        kChanged_CurrentLevel      = 0x0010,
        kChanged_DefaultMoveRate   = 0x0020,
        kChanged_CurrentHue        = 0x0040,
        kChanged_CurrentSaturation = 0x0080,
        kChanged_ColorMode         = 0x0100,
        kChanged_EnhancedColorMode = 0x0200,
        kChanged_Last              = kChanged_EnhancedColorMode,
    } Changed;

    Device(const char * szDeviceName, const char * szLocation);

    bool IsOn() const;
    bool IsReachable() const;
    void SetOnOff(bool aOn);

    void SetLevel(uint8_t aLevel);
    inline uint8_t GetLevel() { return mLevel; };

    void SetDefaultMoveRate(uint8_t aDefaultMoveRate);
    inline uint8_t GetDefaultMoveRate() { return mDefaultMoveRate; };

    void SetCurrentHue(uint8_t aCurrentHue);
    inline uint8_t GetCurrentHue() { return mCurrentHue; };

    void SetCurrentSaturation(uint8_t aCurrentSaturation);
    inline uint8_t GetCurrentSaturation() { return mCurrentSaturation; };

    void SetColorMode(uint8_t aColorMode);
    inline uint8_t GetColorMode() { return mColorMode; };

    void SetEnhancedColorMode(uint8_t aEnhancedColorMode);
    inline uint8_t GetEnhancedColorMode() { return mEnhancedColorMode; };

    void SetReachable(bool aReachable);
    void SetName(const char * szDeviceName);
    void SetLocation(const char * szLocation);
    inline void SetEndpointId(chip::EndpointId id) { mEndpointId = id; };
    inline chip::EndpointId GetEndpointId() { return mEndpointId; };
    inline char * GetName() { return mName; };
    inline char * GetLocation() { return mLocation; };

    using DeviceCallback_fn = std::function<void(Device *, Changed_t)>;
    void SetChangeCallback(DeviceCallback_fn aChanged_CB);

private:
    State_t mState;
    bool mReachable;
    char mName[kDeviceNameSize];
    char mLocation[kDeviceLocationSize];
    chip::EndpointId mEndpointId;
    DeviceCallback_fn mChanged_CB;
    uint8_t mLevel;
    uint8_t mDefaultMoveRate;
    uint8_t mCurrentHue;
    uint8_t mCurrentSaturation;
    uint8_t mColorMode;
    uint8_t mEnhancedColorMode;
};

class DeviceTempSensor : public Device
{
public:
    enum Changed_t
    {
        kChanged_MeasurementValue = kChanged_Last << 1,
    } Changed;

    DeviceTempSensor(const char * szDeviceName, std::string szLocation, int16_t min, int16_t max, int16_t measuredValue);

    inline int16_t GetMeasuredValue() { return mMeasurement; };
    void SetMeasuredValue(int16_t measurement);

    using DeviceCallback_fn = std::function<void(DeviceTempSensor *, DeviceTempSensor::Changed_t)>;
    void SetChangeCallback(DeviceCallback_fn aChanged_CB);

    const int16_t mMin;
    const int16_t mMax;

private:
    void HandleDeviceChange(Device * device, Device::Changed_t changeMask);

private:
    int16_t mMeasurement;
    DeviceCallback_fn mChanged_CB;
};
```

## src/Device.cpp
```c
/*
 *
 *    Copyright (c) 2023 Project CHIP Authors
 *
 *    Licensed under the Apache License, Version 2.0 (the "License");
 *    you may not use this file except in compliance with the License.
 *    You may obtain a copy of the License at
 *
 *        http://www.apache.org/licenses/LICENSE-2.0
 *
 *    Unless required by applicable law or agreed to in writing, software
 *    distributed under the License is distributed on an "AS IS" BASIS,
 *    WITHOUT WARRANTIES OR CONDITIONS OF ANY KIND, either express or implied.
 *    See the License for the specific language governing permissions and
 *    limitations under the License.
 */

#include "Device.h"

#include <cstdio>
#include <lib/support/CHIPMemString.h>
#include <platform/CHIPDeviceLayer.h>

#include <string>

#define debug_msg(a, ...) printk("[ D ] %d %s(): " a, __LINE__, __func__, ##__VA_ARGS__)

using namespace ::chip::Platform;

Device::Device(const char * szDeviceName, const char * szLocation)
{
    CopyString(mName, sizeof(mName), szDeviceName);
    CopyString(mLocation, sizeof(mLocation), szLocation);
    mState      = kState_Off;
    mReachable  = false;
    mEndpointId = 0;
    mChanged_CB = nullptr;
}

bool Device::IsOn() const
{
    return mState == kState_On;
}

bool Device::IsReachable() const
{
    return mReachable;
}

void Device::SetOnOff(bool aOn)
{
    bool changed;

    if (aOn)
    {
        changed = (mState != kState_On);
        mState  = kState_On;
        ChipLogProgress(DeviceLayer, "Device[%s]: ON", mName);
    }
    else
    {
        changed = (mState != kState_Off);
        mState  = kState_Off;
        ChipLogProgress(DeviceLayer, "Device[%s]: OFF", mName);
    }

    if (changed && mChanged_CB)
    {
        mChanged_CB(this, kChanged_State);
    }
}

void Device::SetLevel(uint8_t aLevel)
{
    debug_msg("aLevel[%d]\n", aLevel);
    bool changed = false;

    if (aLevel)
    {
        debug_msg("\n");
        changed = (mLevel != aLevel);
        mLevel  = aLevel;
        debug_msg("Device[%s]: set Level [%d]\n", mName, aLevel);
    }

    if (changed && mChanged_CB)
    {
        debug_msg("\n");
        mChanged_CB(this, kChanged_CurrentLevel);
        debug_msg("\n");
    }
}

void Device::SetDefaultMoveRate(uint8_t aDefaultMoveRate)
{
    debug_msg("aDefaultMoveRate[%d]\n", aDefaultMoveRate);
    bool changed = false;

    if (aDefaultMoveRate)
    {
        debug_msg("\n");
        changed          = (mDefaultMoveRate != aDefaultMoveRate);
        mDefaultMoveRate = aDefaultMoveRate;
        ChipLogProgress(DeviceLayer, "Device[%s]: set DefaultMoveRate [%d]", mName, aDefaultMoveRate);
    }

    if (changed && mChanged_CB)
    {
        debug_msg("\n");
        mChanged_CB(this, kChanged_DefaultMoveRate);
        debug_msg("\n");
    }
}

void Device::SetCurrentHue(uint8_t aCurrentHue)
{
    debug_msg("aCurrentHue[%d]\n", aCurrentHue);
    bool changed = false;

    debug_msg("\n");
    changed     = (mCurrentHue != aCurrentHue);
    mCurrentHue = aCurrentHue;
    ChipLogProgress(DeviceLayer, "Device[%s]: set CurrentHue [%d]", mName, aCurrentHue);

    if (changed && mChanged_CB)
    {
        debug_msg("\n");
        mChanged_CB(this, kChanged_CurrentHue);
        debug_msg("\n");
    }
}

void Device::SetCurrentSaturation(uint8_t aCurrentSaturation)
{
    debug_msg("aCurrentSaturation[%d]\n", aCurrentSaturation);
    bool changed = false;

    debug_msg("\n");
    changed            = (mCurrentSaturation != aCurrentSaturation);
    mCurrentSaturation = aCurrentSaturation;
    ChipLogProgress(DeviceLayer, "Device[%s]: set Changed_CurrentSaturation [%d]", mName, aCurrentSaturation);

    if (changed && mChanged_CB)
    {
        debug_msg("\n");
        mChanged_CB(this, kChanged_CurrentSaturation);
        debug_msg("\n");
    }
}

void Device::SetColorMode(uint8_t aColorMode)
{
    debug_msg("aColorMode[%d]\n", aColorMode);
    bool changed = false;

    debug_msg("\n");
    changed    = (mColorMode != aColorMode);
    mColorMode = aColorMode;
    ChipLogProgress(DeviceLayer, "Device[%s]: set Changed_ColorMode [%d]", mName, aColorMode);

    if (changed && mChanged_CB)
    {
        debug_msg("\n");
        mChanged_CB(this, kChanged_ColorMode);
        debug_msg("\n");
    }
}

void Device::SetEnhancedColorMode(uint8_t aEnhancedColorMode)
{
    debug_msg("aEnhancedColorMode[%d]\n", aEnhancedColorMode);
    bool changed = false;

    debug_msg("\n");
    changed            = (mEnhancedColorMode != aEnhancedColorMode);
    mEnhancedColorMode = aEnhancedColorMode;
    ChipLogProgress(DeviceLayer, "Device[%s]: set Changed_ColorMode [%d]", mName, aEnhancedColorMode);

    if (changed && mChanged_CB)
    {
        debug_msg("\n");
        mChanged_CB(this, kChanged_EnhancedColorMode);
        debug_msg("\n");
    }
}

void Device::SetReachable(bool aReachable)
{
    bool changed = (mReachable != aReachable);

    mReachable = aReachable;

    if (aReachable)
    {
        ChipLogProgress(DeviceLayer, "Device[%s]: ONLINE", mName);
    }
    else
    {
        ChipLogProgress(DeviceLayer, "Device[%s]: OFFLINE", mName);
    }

    if (changed && mChanged_CB)
    {
        mChanged_CB(this, kChanged_Reachable);
    }
}

void Device::SetName(const char * szName)
{
    bool changed = (strncmp(mName, szName, sizeof(mName)) != 0);

    ChipLogProgress(DeviceLayer, "Device[%s]: New Name=\"%s\"", mName, szName);

    CopyString(mName, sizeof(mName), szName);

    if (changed && mChanged_CB)
    {
        mChanged_CB(this, kChanged_Name);
    }
}

void Device::SetLocation(const char * szLocation)
{
    bool changed = (strncmp(mLocation, szLocation, sizeof(mLocation)) != 0);

    CopyString(mLocation, sizeof(mLocation), szLocation);

    ChipLogProgress(DeviceLayer, "Device[%s]: Location=\"%s\"", mName, mLocation);

    if (changed && mChanged_CB)
    {
        mChanged_CB(this, kChanged_Location);
    }
}

void Device::SetChangeCallback(DeviceCallback_fn aChanged_CB)
{
    mChanged_CB = aChanged_CB;
}

DeviceTempSensor::DeviceTempSensor(const char * szDeviceName, std::string szLocation, int16_t min, int16_t max,
                                   int16_t measuredValue) :
    Device(szDeviceName, szLocation.c_str()), mMin(min), mMax(max), mMeasurement(measuredValue)
{}

void DeviceTempSensor::SetMeasuredValue(int16_t measurement)
{
    // Limit measurement based on the min and max.
    if (measurement < mMin)
    {
        measurement = mMin;
    }
    else if (measurement > mMax)
    {
        measurement = mMax;
    }

    bool changed = mMeasurement != measurement;

    ChipLogProgress(DeviceLayer, "TempSensorDevice new measurement=\"%d\"", measurement);

    mMeasurement = measurement;

    if (changed && mChanged_CB)
    {
        mChanged_CB(this, kChanged_MeasurementValue);
    }
}

void DeviceTempSensor::SetChangeCallback(DeviceCallback_fn aChanged_CB)
{
    mChanged_CB = aChanged_CB;
}

void DeviceTempSensor::HandleDeviceChange(Device * device, Device::Changed_t changeMask)
{
    if (mChanged_CB)
    {
        mChanged_CB(this, (DeviceTempSensor::Changed_t) changeMask);
    }
}
```
